// aurora_corne.dtsi

/ {
    led_strip: led_strip {
        compatible = "worldsemi,ws2812-spi";
        chain-length = <21>;
        spi-max-frequency = <4000000>;
        color-mapping = <LED_COLOR_ID_GREEN LED_COLOR_ID_RED LED_COLOR_ID_BLUE>;
    };
};
