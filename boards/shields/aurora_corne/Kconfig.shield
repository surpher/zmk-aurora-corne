## boards/shields/aurora_corne/Kconfig.shield
```kconfig
# Copyright (c) 2025 Surpher
# SPDX-License-Identifier: MIT

config SHIELD_AURORA_CORNE_LEFT
    def_bool $(shields_list_contains,aurora_corne_left)

config SHIELD_AURORA_CORNE_RIGHT
    def_bool $(shields_list_contains,aurora_corne_right)
```
